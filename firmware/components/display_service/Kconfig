## firmware/components/display_service/Kconfig
```kconfig
menu "Temperature monitor LCD"

config MONITOR_LCD_ST7735
	bool "Use 128x160 ST7735 LCD"
	default y
	help
		Select the connected 1.8-inch ST7735 module. Disable for the
		original 240x320 ST7789 display.

config MONITOR_LCD_TEST_PATTERN
	bool "Show LCD color and orientation diagnostics"
	default n
	help
		Replace the normal display view with RGB bars and corner markers for
		physical panel bring-up. Keep disabled for normal firmware builds.

config MONITOR_LCD_FLUSH_DIAG
	bool "Log LVGL flush-to-transfer-complete timing on the normal UI"
	default n
	help
		Every ten seconds log LCD_DIAG flush_us with the cumulative count,
		minimum, average and maximum time from LVGL flush start to SPI transfer
		completion. This replaces esp_lvgl_port's transfer-done callback with an
		equivalent one that timestamps first. It is software timing, not optical
		refresh latency. Keep disabled for normal firmware builds.

endmenu
```

## firmware/main/Kconfig.projbuild
```kconfig
menu "Temperature monitor peripherals"
config MONITOR_SIMULATION
    bool "Development-only simulated probes and accelerated history"
    default n
    help
        Runs five explicitly simulated probes without touching GPIO4. Uses separate
        NVS/history storage and marks every API snapshot as simulated. Never use as
        evidence of physical sensor verification.
config MONITOR_SIM_REPLACEMENT_TEST
    bool "Simulate a disconnected saved probe and one excess replacement ROM"
    depends on MONITOR_SIMULATION
    default n
    help
        Test-only simulation mode. Omits ROM 1 from readings and adds ROM 6 so a
        saved five-probe registry can exercise durable retirement and replacement.
        It never enables or accesses the physical sensor bus.
config MONITOR_SENSOR_BUS
    bool "Enable physical DS18B20 bus on GPIO4"
    depends on !MONITOR_SIMULATION
    default n
    help
        Enable after connecting the powered probes and a single external 4.7k pull-up.
        Leave disabled for bare-board tests. This does not enable the LCD/backlight.
endmenu
```

## firmware/sdkconfig.defaults
```kconfig
CONFIG_IDF_TARGET="esp32s3"
CONFIG_ESPTOOLPY_FLASHSIZE_16MB=y
CONFIG_SPIRAM=y
CONFIG_SPIRAM_MODE_OCT=y
CONFIG_SPIRAM_SPEED_80M=y
CONFIG_SPIRAM_IGNORE_NOTFOUND=y
CONFIG_ESP_CONSOLE_USB_SERIAL_JTAG=y
CONFIG_PARTITION_TABLE_CUSTOM=y
CONFIG_PARTITION_TABLE_CUSTOM_FILENAME="partitions.csv"
CONFIG_BOOTLOADER_APP_ROLLBACK_ENABLE=y
CONFIG_HTTPD_WS_SUPPORT=y
CONFIG_HTTPD_WS_PRE_HANDSHAKE_CB_SUPPORT=y
CONFIG_CJSON_NESTING_LIMIT=16
CONFIG_CJSON_CIRCULAR_LIMIT=32
CONFIG_ESP_MAIN_TASK_STACK_SIZE=8192
CONFIG_LV_FONT_MONTSERRAT_12=y
CONFIG_LV_FONT_MONTSERRAT_24=y
```
